## conf/distro/final-project.conf
```bitbake
include ../../../meta-tegrademo/conf/distro/tegrademo.conf
REQUIRED_TD_BBLAYERS_CONF_VERSION = "${DISTRO}-3"

DISTRO = "final-project"
DISTRO_NAME = "OE4Tegra Demonstration Distro With AESD Final Project Code"

DISTRO_VERSION = "${DISTRO_VERSION_BASE}+snapshot"
DISTRO_CODENAME = "aesd-final-project"
DISTRO_LAYER = "meta-final-project"

IMAGE_INSTALL_append = " project-server arduino_cli"

BUILDNAME ?= "${@d.getVar('DISTRO_VERSION').replace('+snapshot','')}${DISTRO_LAYER_BUILDTAG}"
BUILDNAME[vardepvalue] = "${DISTRO_VERSION}"
```

## conf/layer.conf
```bitbake
# We have a conf and classes directory, add to BBPATH
BBPATH .= ":${LAYERDIR}"
# We have recipes-* directories, add to BBFILES
BBFILES += " \
    ${LAYERDIR}/recipes-*/*/*.bb \
    ${LAYERDIR}/recipes-*/*/*.bbappend \
"

BBFILE_COLLECTIONS += "final-project"
BBFILE_PATTERN_final-project = "^${LAYERDIR}/"
BBFILE_PRIORITY_final-project = "10"

LAYERVERSION_final-project = "1"
LAYERSERIES_COMPAT_final-project = "dunfell gatesgarth hardknott"
LAYERDEPENDS_final-project = "tegrademo"

# This is used by the tegra-distro-sanity bbclass
# to identify the distro layer directory during
# bblayers checks.
TD_DISTRO_LAYERDIR = "${LAYERDIR}"
```
